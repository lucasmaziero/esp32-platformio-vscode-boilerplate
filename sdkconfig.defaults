## sdkconfig.defaults
```kconfig
# PlatformIO Menuconfig IDF: pio run --target menuconfig --environment esp32dev

# Override some defaults to enable Arduino framework (pio run --target menuconfig --environment esp32dev )
CONFIG_ENABLE_ARDUINO_DEPENDS=y
CONFIG_AUTOSTART_ARDUINO=n
CONFIG_ARDUINO_RUN_CORE1=y
CONFIG_ARDUINO_RUNNING_CORE=1
CONFIG_ARDUINO_EVENT_RUN_CORE1=y
CONFIG_ARDUINO_EVENT_RUNNING_CORE=1
CONFIG_ARDUINO_UDP_RUN_CORE1=y
CONFIG_ARDUINO_UDP_RUNNING_CORE=1
CONFIG_DISABLE_HAL_LOCKS=y
CONFIG_ARDUHAL_LOG_DEFAULT_LEVEL_ERROR=y
CONFIG_ARDUHAL_LOG_DEFAULT_LEVEL=1
CONFIG_ARDUHAL_PARTITION_SCHEME_DEFAULT=y
CONFIG_ARDUHAL_PARTITION_SCHEME="default"
CONFIG_AUTOCONNECT_WIFI=y
CONFIG_ARDUINO_SELECTIVE_WiFi=y
CONFIG_MBEDTLS_PSK_MODES=y
CONFIG_MBEDTLS_KEY_EXCHANGE_PSK=y

# Override some defaults to FreeRTOS
CONFIG_FREERTOS_HZ=1000

# Override some defaults to ESP System
CONFIG_ESP_MAIN_TASK_STACK_SIZE=8192

# Override some defaults to Partition Table
CONFIG_PARTITION_TABLE_CUSTOM=y
CONFIG_PARTITION_TABLE_CUSTOM_FILENAME="partitions/partitions.csv"
CONFIG_PARTITION_TABLE_FILENAME="partitions/partitions.csv"
CONFIG_PARTITION_TABLE_OFFSET=0x8000
CONFIG_PARTITION_TABLE_MD5=y

# Override some defaults to Log output
# Log options: NONE | ERROR | WARN | INFO (default) | DEBUG | VERBOSE
# https://espressif-docs.readthedocs-hosted.com/projects/espressif-esp-faq/en/latest/development-environment/debugging.html
# make menuconfig > Bootloader config
# make menuconfig > Component config > Log output
CONFIG_BOOTLOADER_LOG_LEVEL_INFO=y
CONFIG_LOG_DEFAULT_LEVEL_INFO=y
```
